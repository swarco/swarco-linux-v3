## configs/swarco_linux_v3.1_scc-air-v2_sama5_docker_defconfig
```kconfig
BR2_arm=y
BR2_cortex_a5=y
BR2_ARM_ENABLE_VFP=y
BR2_ARM_EABI=y
BR2_WGET="wget --passive-ftp -nd"
BR2_DL_DIR="$(BASE_DIR)/dl"
BR2_KERNEL_MIRROR="http://www.kernel.org/pub/"
BR2_TOOLCHAIN_BUILDROOT_GLIBC=y
BR2_KERNEL_HEADERS_5_4=y
BR2_GCC_VERSION_12_X=y
BR2_EXTRA_GCC_CONFIG_OPTIONS="--disable-libssp"
BR2_TOOLCHAIN_BUILDROOT_CXX=y
BR2_PACKAGE_HOST_GDB=y
BR2_TARGET_OPTIMIZATION="-Os -pipe"
BR2_TARGET_GENERIC_HOSTNAME="swarco-linux"
BR2_TARGET_GENERIC_ISSUE=""
BR2_ROOTFS_DEVICE_CREATION_DYNAMIC_MDEV=y
BR2_ROOTFS_DEVICE_TABLE="system/device_table.txt board/swarco/device_table_ext.txt"
BR2_TARGET_GENERIC_ROOT_PASSWD="root"
BR2_ROOTFS_OVERLAY="board/swarco/common/rootfs_overlay"
BR2_ROOTFS_POST_BUILD_SCRIPT="board/swarco/scc-air-v2/post-build.sh"
BR2_ROOTFS_POST_IMAGE_SCRIPT="board/swarco/scc-air-v2/post-image.sh"
BR2_ROOTFS_POST_SCRIPT_ARGS="scc-air-v2"
BR2_LINUX_KERNEL=y
BR2_LINUX_KERNEL_CUSTOM_GIT=y
BR2_LINUX_KERNEL_CUSTOM_REPO_URL="https://github.com/swarco/linux-kernel"
BR2_LINUX_KERNEL_CUSTOM_REPO_VERSION="v5.4.137-scc-sama5"
BR2_LINUX_KERNEL_USE_CUSTOM_CONFIG=y
BR2_LINUX_KERNEL_CUSTOM_CONFIG_FILE="board/swarco/scc-air-v2/kernel/v5.4/kernel-config-docker"
BR2_LINUX_KERNEL_CONFIG_FRAGMENT_FILES="board/swarco/common/initramfs/config_initramfs_source"
BR2_LINUX_KERNEL_DTS_SUPPORT=y
BR2_LINUX_KERNEL_CUSTOM_DTS_PATH="board/swarco/scc-air-v2/kernel/v5.4/sama5d35-swarco-scc-air-mk2.dts"
BR2_PACKAGE_BUSYBOX_CONFIG="board/swarco/busybox.config"
BR2_PACKAGE_GDB=y
BR2_PACKAGE_GDB_SERVER=y
BR2_PACKAGE_GDB_DEBUGGER=y
BR2_PACKAGE_STRACE=y
BR2_PACKAGE_E2FSPROGS=y
# BR2_PACKAGE_E2FSPROGS_FSCK is not set
BR2_PACKAGE_MTD=y
BR2_PACKAGE_MTD_DOCFDISK=y
BR2_PACKAGE_MTD_DOC_LOADBIOS=y
BR2_PACKAGE_MTD_FTL_CHECK=y
BR2_PACKAGE_MTD_FTL_FORMAT=y
BR2_PACKAGE_MTD_MKFSUBIFS=y
BR2_PACKAGE_MTD_NFTLDUMP=y
BR2_PACKAGE_MTD_NFTL_FORMAT=y
BR2_PACKAGE_MTD_SUMTOOL=y
BR2_PACKAGE_IMAGEMAGICK=y
BR2_PACKAGE_RNG_TOOLS=y
BR2_PACKAGE_SETSERIAL=y
BR2_PACKAGE_USB_MODESWITCH=y
BR2_PACKAGE_PIXMAN=y
BR2_PACKAGE_LIBGPIOD=y
BR2_PACKAGE_LIBGPIOD_TOOLS=y
BR2_PACKAGE_TSLIB=y
BR2_PACKAGE_EXPAT=y
BR2_PACKAGE_LIBTIRPC=y
BR2_PACKAGE_GMP=y
BR2_PACKAGE_LIBCAP=y
BR2_PACKAGE_LIBEVDEV=y
BR2_PACKAGE_ETHTOOL=y
BR2_PACKAGE_LIGHTTPD=y
BR2_PACKAGE_LIGHTTPD_OPENSSL=y
BR2_PACKAGE_LIGHTTPD_ZLIB=y
BR2_PACKAGE_LRZSZ=y
BR2_PACKAGE_MOSQUITTO=y
BR2_PACKAGE_MOSQUITTO_BROKER=y
BR2_PACKAGE_NETSNMP=y
BR2_PACKAGE_NTP=y
BR2_PACKAGE_NTP_SNTP=y
BR2_PACKAGE_NTP_NTPDATE=y
BR2_PACKAGE_NTP_NTPQ=y
BR2_PACKAGE_OPENSSH=y
BR2_PACKAGE_OPENVPN=y
BR2_PACKAGE_PPPD=y
BR2_PACKAGE_SER2NET=y
BR2_PACKAGE_STUNNEL=y
BR2_PACKAGE_TINC=y
BR2_PACKAGE_DIALOG=y
BR2_PACKAGE_DOCKER_CLI=y
BR2_PACKAGE_DOCKER_COMPOSE=y
BR2_PACKAGE_DOCKER_ENGINE=y
BR2_PACKAGE_NANO=y
BR2_PACKAGE_QEMACS=y
BR2_PACKAGE_SWARCO_USERMODE_TOOLS=y
BR2_PACKAGE_MOBILE_DATA_CONNECTOR=y
# BR2_TARGET_ROOTFS_TAR is not set
BR2_TARGET_ROOTFS_UBIFS=y
BR2_TARGET_ROOTFS_UBIFS_LEBSIZE=0x1f000
```

## configs/swarco_linux_v3_ccm2200_defconfig
```kconfig
BR2_arm=y
BR2_arm920t=y
BR2_WGET="wget --passive-ftp -nd"
BR2_DL_DIR="$(BASE_DIR)/dl"
BR2_KERNEL_MIRROR="http://www.kernel.org/pub/"
BR2_JLEVEL=1
BR2_KERNEL_HEADERS_4_5=y
BR2_TOOLCHAIN_BUILDROOT_GLIBC=y
BR2_GLIBC_VERSION_2_23=y
BR2_BINUTILS_VERSION_2_26_X=y
BR2_EXTRA_GCC_CONFIG_OPTIONS="--disable-libssp"
BR2_TOOLCHAIN_BUILDROOT_CXX=y
BR2_PACKAGE_HOST_GDB=y
BR2_GDB_VERSION_7_10=y
BR2_ENABLE_LOCALE_PURGE=y
BR2_TARGET_OPTIMIZATION="-Os -pipe"
BR2_TARGET_GENERIC_HOSTNAME="swarco-linux"
BR2_TARGET_GENERIC_ISSUE="Welcome to SWARCO Linux V3"
BR2_ROOTFS_DEVICE_CREATION_DYNAMIC_MDEV=y
BR2_ROOTFS_DEVICE_TABLE="system/device_table.txt board/swarco/device_table_ext.txt"
BR2_TARGET_GENERIC_ROOT_PASSWD="root"
BR2_ROOTFS_OVERLAY="board/swarco/ccm2200/rootfs_overlay"
BR2_LINUX_KERNEL=y
BR2_LINUX_KERNEL_CUSTOM_GIT=y
BR2_LINUX_KERNEL_CUSTOM_REPO_URL="https://github.com/swarco/linux-kernel"
BR2_LINUX_KERNEL_CUSTOM_REPO_VERSION="linux-3.4.y-ccm2200"
BR2_LINUX_KERNEL_DEFCONFIG="swarco_ccm2200"
BR2_LINUX_KERNEL_UIMAGE=y
BR2_PACKAGE_BUSYBOX_CONFIG="board/swarco/busybox.config"
BR2_PACKAGE_GDB=y
BR2_PACKAGE_STRACE=y
BR2_PACKAGE_E2FSPROGS=y
# BR2_PACKAGE_E2FSPROGS_DUMPE2FS is not set
# BR2_PACKAGE_E2FSPROGS_FSCK is not set
# BR2_PACKAGE_E2FSPROGS_LOGSAVE is not set
BR2_PACKAGE_MTD=y
BR2_PACKAGE_MTD_DOCFDISK=y
BR2_PACKAGE_MTD_DOC_LOADBIOS=y
BR2_PACKAGE_MTD_FTL_CHECK=y
BR2_PACKAGE_MTD_FTL_FORMAT=y
BR2_PACKAGE_MTD_MKFSUBIFS=y
BR2_PACKAGE_MTD_NFTLDUMP=y
BR2_PACKAGE_MTD_NFTL_FORMAT=y
BR2_PACKAGE_MTD_SUMTOOL=y
BR2_PACKAGE_SETSERIAL=y
BR2_PACKAGE_USB_MODESWITCH=y
BR2_PACKAGE_CAIRO=y
BR2_PACKAGE_TSLIB=y
BR2_PACKAGE_LIBEVDEV=y
BR2_PACKAGE_ETHTOOL=y
BR2_PACKAGE_IPTABLES=y
BR2_PACKAGE_LIGHTTPD=y
BR2_PACKAGE_LIGHTTPD_ZLIB=y
BR2_PACKAGE_LRZSZ=y
BR2_PACKAGE_NETSNMP=y
BR2_PACKAGE_NTP=y
BR2_PACKAGE_NTP_SNTP=y
BR2_PACKAGE_OPENSSH=y
BR2_PACKAGE_OPENVPN=y
BR2_PACKAGE_PPPD=y
BR2_PACKAGE_SER2NET=y
BR2_PACKAGE_STUNNEL=y
BR2_PACKAGE_TINC=y
BR2_PACKAGE_DIALOG=y
BR2_PACKAGE_NANO=y
BR2_PACKAGE_SWARCO_USERMODE_TOOLS=y
BR2_TARGET_ROOTFS_TAR_BZIP2=y
BR2_TARGET_ROOTFS_UBIFS=y
```

## package/swarco/Config.in
```kconfig
#commented packages are not necessary in current buildroot
#files are moved in old_package directory
menu "SWARCO Traffic Systems Extensions"
# source "swarco/package/bluez-libs/Config.in"
# source "swarco/package/bluez-utils/Config.in"
# source "swarco/package/goahead/Config.in"
# #source "swarco/package/samba_swarco/Config.in"
# #source "swarco/package/nmbd/Config.in"
# # source "swarco/package/fuser/Config.in" => now in psmisc
# source "swarco/package/zeroconf/Config.in"
# source "swarco/package/updatedd/Config.in"
# source "swarco/package/sqlite/Config.in"
# source "swarco/package/cifs/Config.in"
# source "swarco/package/mgetty/Config.in"
# #source "swarco/package/proftpd/Config.in"
# #source "swarco/package/yaffs2/Config.in"
# #source "swarco/package/perl/Config.in"
# source "swarco/package/wuftpd/Config.in"
# #source "swarco/package/imagemagick/Config.in"
# source "swarco/package/qemacs/Config.in"
# #source "swarco/package/comgt/Config.in"
# source "swarco/package/vlan/Config.in"
# source "swarco/package/ser2net/Config.in"
# source "swarco/package/usb_modeswitch/Config.in"
# source "swarco/package/tinc/Config.in"
source "package/swarco/swarco-usermode-tools/Config.in"

endmenu
```

## package/swarco/mobile-data-connector/Config.in
```kconfig
config BR2_PACKAGE_MOBILE_DATA_CONNECTOR
	bool "SWARCO Mobile Data Connector"
	depends on BR2_USE_MMU # fork()
	depends on !BR2_STATIC_LIBS
	help
          Scripts to connect mobile telefone network packet data services
          (LTE, HSDPA, UMTS, GPRS)

	  https://github.com/swarco/mobile-data-connector
```

## package/swarco/qemacs/Config.in
```kconfig
config BR2_PACKAGE_QEMACS
        bool "qemacs Text Editor"
	default n
	help
	  QEmacs Text Editor
```

## package/swarco/swarco-usermode-tools/Config.in
```kconfig
config BR2_PACKAGE_SWARCO_USERMODE_TOOLS
	bool "Usermode tools to enable special functions on SWARCO boards"
	depends on BR2_USE_MMU # fork()
	depends on !BR2_STATIC_LIBS
	help
          Usermode tools to enable special functions on SWARCO boards

	  https://github.com/swarco/swarco-usermode-tools
```
